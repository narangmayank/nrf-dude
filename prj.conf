## CMakeLists.txt
```
cmake_minimum_required(VERSION 3.13.0)

find_package(Zephyr REQUIRED HINTS $ENV{ZEPHYR_BASE})
project(RunTimeCli)

# no need of unity_memroy src as of now
add_definitions(-DUNITY_FIXTURE_NO_EXTRAS)
 
# add unity_fixture module to the project (i.e not included inside unity CMakeLists)
zephyr_include_directories(${ZEPHYR_BASE}/../test/cmock/vendor/unity/extras/fixture/src)
target_sources(app PRIVATE ${ZEPHYR_BASE}/../test/cmock/vendor/unity/extras/fixture/src/unity_fixture.c)

# header files
zephyr_include_directories(src/App)
zephyr_include_directories(src/Drivers)
zephyr_include_directories(src/Utils)
zephyr_include_directories(test/TestRunner)

# source files
target_sources(app PRIVATE src/main.c)
target_sources(app PRIVATE src/App/Cli/Cli.c)
target_sources(app PRIVATE src/App/Cli/CmdHandler.c)
target_sources(app PRIVATE src/App/UartThread/UartThread.c)
target_sources(app PRIVATE src/Drivers/LedDriver/LedDriver.c)
target_sources(app PRIVATE src/Drivers/UartDriver/UartDriver.c)
target_sources(app PRIVATE src/Utils/DriveDriver.c)

# test files
target_sources(app PRIVATE test/LedTest.c)
target_sources(app PRIVATE test/UartTest.c)
target_sources(app PRIVATE test/TestRunner/TestRunner.c)
```

## prj.conf
```kconfig
# UNITY
CONFIG_UNITY=y

#GPIO
CONFIG_GPIO=y

# UART
CONFIG_SERIAL=y
CONFIG_UART_ASYNC_API=y

# Segger RTT
CONFIG_LOG=y
CONFIG_USE_SEGGER_RTT=y
CONFIG_RTT_CONSOLE=y
CONFIG_UART_CONSOLE=y
CONFIG_LOG_BACKEND_RTT=y
CONFIG_LOG_BACKEND_UART=y
```

## nrf9160dk_nrf9160_ns.overlay
```dts
&uart2 {
	status = "okay";
	label = "UART_2";
	current-speed = < 0x1c200 >;
	tx-pin = < 0x18 >;
      rx-pin = < 0x17 >;
}; 
```

## boards/nrf9160dk_nrf9160_ns.overlay
```dts
&uart2 {
	status = "okay";
	label = "UART_2";
	current-speed = < 0x1c200 >;
}; 
```

## src/main.c
```c
/*
 * Copyright (c) 2016 Intel Corporation
 *
 * SPDX-License-Identifier: Apache-2.0
 */

#include "DriveDriver.h"
#include "LedDriver/LedDriver.h"
#include "UartDriver/UartDriver.h"
#include <zephyr.h>
#include <device.h>
#include <kernel.h>
#include <devicetree.h>
#include <sys/printk.h>

#define RUN_UNIT_TEST 0
#define RUN_FUNCTIONALITY_TEST 0

const struct device * uartDev_2 = NULL;

void main(void) {
  
  #if RUN_FUNCTIONALITY_TEST
    printk("driveLed()  err_code : %d\n",driveLed());
    printk("driveUart() err_code : %d\n",driveUart());
  #endif
  
  #if RUN_UNIT_TEST
    extern int unity_main(void);
    printk("unity_main() err_code : %d",unity_main());
  #endif

  int err_code = UartDriver_Create(&uartDev_2, UART_PORT_2, UART_BAUDRATE_115200);
  printk("UartDriver_Create() err_code : %d", err_code);
}
```
